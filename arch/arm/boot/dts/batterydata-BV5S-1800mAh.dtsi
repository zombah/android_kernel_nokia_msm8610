/* Copyright (c) 2013, The Linux Foundation. All rights reserved.
 *
 * This program is free software; you can redistribute it and/or modify
 * it under the terms of the GNU General Public License version 2 and
 * only version 2 as published by the Free Software Foundation.
 *
 * This program is distributed in the hope that it will be useful,
 * but WITHOUT ANY WARRANTY; without even the implied warranty of
 * MERCHANTABILITY or FITNESS FOR A PARTICULAR PURPOSE.  See the
 * GNU General Public License for more details.
 */

qcom,nokia-BV5S-1800mAh {
	qcom,fcc-mah = <1800>;
	qcom,default-rbatt-mohm = <113>;
	qcom,max-voltage-uv = <4340000>;
	qcom,rbatt-capacitive-mohm = <50>;
	qcom,v-cutoff-uv = <3400000>;
	qcom,chg-term-ua = <150000>;
	qcom,batt-id-kohm = <78>;

	qcom,fcc-temp-lut {
		qcom,lut-col-legend = <(-20) 0 25 40 60>;
		qcom,lut-data = <1795 1789 1793 1789 1767>;
	};

	qcom,pc-temp-ocv-lut {
		qcom,lut-col-legend = <(-20) 0 25 40 60>;
		qcom,lut-row-legend = <100 95 90 85 80>,
				<75 70 65 60 55>,
				<50 45 40 35 30>,
				<25 20 16 13 11>,
				<10 9 8 7 6>,
				<5 4 3 2 1>,
				<0>;
		qcom,lut-data = <4322 4300 4305 4291 4281>,
				<4203 4219 4230 4223 4215>,
				<4126 4158 4170 4164 4157>,
				<4077 4102 4114 4110 4103>,
				<3993 4052 4063 4060 4053>,
				<3937 3987 4015 4016 4007>,
				<3894 3944 3973 3971 3966>,
				<3854 3903 3936 3935 3929>,
				<3825 3867 3898 3900 3894>,
				<3809 3838 3853 3854 3849>,
				<3795 3812 3823 3823 3820>,
				<3781 3791 3802 3802 3799>,
				<3767 3777 3786 3786 3782>,
				<3750 3767 3773 3774 3770>,
				<3732 3754 3766 3760 3748>,
				<3712 3735 3753 3745 3727>,
				<3687 3714 3733 3725 3703>,
				<3661 3698 3705 3697 3676>,
				<3636 3685 3684 3677 3662>,
				<3616 3676 3677 3671 3658>,
				<3604 3670 3675 3670 3655>,
				<3589 3662 3672 3667 3651>,
				<3571 3650 3669 3663 3641>,
				<3551 3631 3662 3655 3617>,
				<3526 3603 3645 3637 3580>,
				<3492 3563 3611 3601 3534>,
				<3450 3511 3561 3551 3478>,
				<3389 3442 3497 3488 3409>,
				<3301 3352 3411 3403 3321>,
				<3194 3236 3280 3276 3205>,
				<3000 3000 3000 3000 3000>;
	};

	qcom,rbatt-sf-lut {
		qcom,lut-col-legend = <(-20) 0 25 40 60>;
		qcom,lut-row-legend = <100 95 90 85 80>,
				<75 70 65 60 55>,
				<50 45 40 35 30>,
				<25 20 16 13 11>,
				<10 9 8 7 6>,
				<5 4 3 2 1>;
		qcom,lut-data = <1301 321 100 81 76>,
				<1278 322 100 81 76>,
				<1278 322 100 81 76>,
				<1258 323 103 83 77>,
				<1168 339 106 85 79>,
				<1126 322 112 88 80>,
				<1108 315 118 91 83>,
				<1098 307 128 98 87>,
				<1106 300 134 108 93>,
				<1137 297 110 91 83>,
				<1190 295 101 84 78>,
				<1269 290 100 93 78>,
				<1336 296 102 84 80>,
				<1440 309 100 87 83>,
				<1554 327 104 84 78>,
				<1696 354 106 82 77>,
				<1874 411 108 85 78>,
				<2224 518 112 86 80>,
				<3506 673 112 86 81>,
				<5011 835 116 88 83>,
				<5550 890 117 90 85>,
				<6668 958 121 91 87>,
				<8258 1119 127 93 88>,
				<10199 1337 136 97 93>,
				<13060 1625 142 101 101>,
				<16605 2110 148 104 112>,
				<21490 2829 159 112 127>,
				<28326 3821 180 124 155>,
				<38522 5448 220 143 215>,
				<68540 15134 336 220 1616>;
	};
};
