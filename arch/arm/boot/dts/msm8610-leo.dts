/* Copyright (c) 2013, The Linux Foundation. All rights reserved.
 *
 * This program is free software; you can redistribute it and/or modify
 * it under the terms of the GNU General Public License version 2 and
 * only version 2 as published by the Free Software Foundation.
 *
 * This program is distributed in the hope that it will be useful,
 * but WITHOUT ANY WARRANTY; without even the implied warranty of
 * MERCHANTABILITY or FITNESS FOR A PARTICULAR PURPOSE.  See the
 * GNU General Public License for more details.
 */

/dts-v1/;

/include/ "msm8610-v2.dtsi"
/include/ "msm8610-leo.dtsi"
/include/ "msm8610-camera-sensor-leo.dtsi"
/include/ "c4_touch.dtsi"
/include/ "sms_dtv.dtsi"

/ {
	model = "Qualcomm MSM 8610 LEO";
	compatible = "qcom,msm8610-mtp", "qcom,msm8610", "qcom,mtp";
	qcom,board-id = <0x60 1>;
};


